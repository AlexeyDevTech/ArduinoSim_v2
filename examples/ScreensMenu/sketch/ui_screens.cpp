// Generated by ArduSim from screens.json: edit it on the Экраны tab. Changes made here are overwritten.
#include "ui_screens.h"

LiquidCrystal_I2C uiDisplay(0x27, 20, 4);

static UiScreen uiScreen = UI_HOME;
static bool uiDirty = true;
static uint32_t uiDrawnAt;
static uint32_t uiEnteredAt;
static uint8_t uiMenuIndex;
static uint8_t uiMenuTop;

// A frame is drawn here first. uiFlush sends the panel only the cells that differ, a few on each pass,
// so that a whole new screen neither flickers nor keeps the keys waiting.
static const uint8_t UI_COLUMNS = 20;
static const uint8_t UI_ROWS = 4;
static const uint8_t UI_CELLS = UI_COLUMNS * UI_ROWS;
static const uint8_t UI_CELLS_PER_PASS = 4;

static uint8_t uiFrame[UI_CELLS];
static uint8_t uiPanel[UI_CELLS];
static uint8_t uiColumn;
static uint8_t uiRow;
static uint8_t uiScan;
static uint8_t uiNextCell = UI_CELLS;
static bool uiPending;

void uiAt(int x, int y, int size) {
  (void)size;
  uiColumn = x;
  uiRow = y;
}

// Past the end of a row a text is cut off, not carried to another row.
static void uiPut(uint8_t cell) {
  if (uiColumn < UI_COLUMNS && uiRow < UI_ROWS) {
    uiFrame[uiRow * UI_COLUMNS + uiColumn] = cell;
    uiColumn++;
  }
}

static void uiClear() {
  memset(uiFrame, ' ', UI_CELLS);
  uiColumn = 0;
  uiRow = 0;
}

static void uiShow() {
  uiPending = true;
}

static void uiSendCell(uint8_t at, uint8_t code) {
  if (uiNextCell != at) {
    uiDisplay.setCursor(at % UI_COLUMNS, at / UI_COLUMNS);
  }

  uiDisplay.write(code);
  // Rows do not follow each other in the panel's memory.
  uiNextCell = (at + 1) % UI_COLUMNS == 0 ? UI_CELLS : at + 1;
}

static void uiFlush() {
  if (!uiPending) {
    return;
  }

  uint8_t sent = 0;
  for (uint8_t seen = 0; seen < UI_CELLS && sent < UI_CELLS_PER_PASS; seen++) {
    uint8_t at = uiScan;
    uiScan = at + 1 == UI_CELLS ? 0 : at + 1;
    if (uiFrame[at] != uiPanel[at]) {
      uiSendCell(at, uiFrame[at]);
      uiPanel[at] = uiFrame[at];
      sent++;
    }
  }

  if (sent < UI_CELLS_PER_PASS) {
    uiPending = false;
  }
}

UiOut uiOut;

size_t UiOut::write(uint8_t ch) {
  if (ch >= ' ' && ch < 0x80) {
    uiPut(ch);
  }

  return 1;
}

enum UiAlign : uint8_t {
  UI_LEFT,
  UI_CENTER,
  UI_RIGHT
};

// A text in its field: where it lies there, and cut off at the field's end.
static void uiPlace(int x, int y, int size, int width, UiAlign align, const char* text) {
  int cells = 0;
  for (const char* p = text; *p != 0; p++) {
    if ((*p & 0xC0) != 0x80) {
      cells++;
    }
  }

  int room = width > cells ? width - cells : 0;
  uiAt(x + (align == UI_CENTER ? room / 2 : align == UI_RIGHT ? room : 0) * (1), y, size);
  int left = width;
  for (const char* p = text; *p != 0; p++) {
    if ((*p & 0xC0) != 0x80 && left-- == 0) {
      break;
    }

    uiOut.write((uint8_t)*p);
  }
}

static void uiSayItem_menu1(uint8_t index) {
  switch (index) {
    case 0:
      uiOut.print(F("Sensor"));
      break;
    case 1:
      uiOut.print(F("About"));
      break;
    case 2:
      uiOut.print(F("Back"));
      break;
    default:
      break;
  }
}

static void uiDrawMenu_menu1() {
  if (uiMenuTop + 0 < 3) {
    uiAt(0, 1, 1);
    if (uiMenuTop + 0 == uiMenuIndex) {
      uiOut.print(F(">"));
    } else {
      uiOut.print(F(" "));
    }
    uiSayItem_menu1(uiMenuTop + 0);
  }
  if (uiMenuTop + 1 < 3) {
    uiAt(0, 2, 1);
    if (uiMenuTop + 1 == uiMenuIndex) {
      uiOut.print(F(">"));
    } else {
      uiOut.print(F(" "));
    }
    uiSayItem_menu1(uiMenuTop + 1);
  }
  if (uiMenuTop + 2 < 3) {
    uiAt(0, 3, 1);
    if (uiMenuTop + 2 == uiMenuIndex) {
      uiOut.print(F(">"));
    } else {
      uiOut.print(F(" "));
    }
    uiSayItem_menu1(uiMenuTop + 2);
  }
}

// Главный
static void uiDraw_home() {
  uiAt(0, 0, 1);
  uiOut.print(F("ArduSim screens"));
  uiAt(0, 2, 1);
  uiOut.print(F("Up:"));
  {
    char text[16] = "";
    uiValue_uptime(text, sizeof text);
    uiPlace(4, 2, 1, 5, UI_LEFT, text);
  }
  uiAt(0, 3, 1);
  uiOut.print(F("Press knob: menu"));
}

// Датчик
static void uiDraw_screen1() {
  uiAt(0, 0, 1);
  uiOut.print(F("Sensor on A0"));
  {
    char text[16] = "";
    uiValue_adc(text, sizeof text);
    uiPlace(0, 1, 1, 5, UI_LEFT, text);
  }
  uiAt(0, 3, 1);
  uiOut.print(F("Press knob: menu"));
}

// О программе
static void uiDraw_screen2() {
  uiAt(0, 0, 1);
  uiOut.print(F("Made on the map"));
  uiAt(0, 1, 1);
  uiOut.print(F("of the Screens tab"));
}

// Меню
static void uiDraw_menu1() {
  uiAt(0, 0, 1);
  uiOut.print(F("Menu"));
  uiDrawMenu_menu1();
}

static void uiDrawScreen() {
  uiClear();
  switch (uiScreen) {
    case UI_HOME:
      uiDraw_home();
      break;
    case UI_SCREEN1:
      uiDraw_screen1();
      break;
    case UI_SCREEN2:
      uiDraw_screen2();
      break;
    case UI_MENU1:
      uiDraw_menu1();
      break;
    default:
      break;
  }
  uiShow();
}

static bool uiArrive() {
  uiMenuIndex = 0;
  uiMenuTop = 0;
  return true;
}

static void uiEnter(UiScreen next) {
  uiScreen = next;
  uiEnteredAt = millis();
  uiDirty = true;
  uiArrive();
}

void uiGoTo(UiScreen screen) {
  uiEnter(screen);
}

void uiRedraw() {
  uiDirty = true;
}

UiScreen uiCurrent() {
  return uiScreen;
}

// What an event does on each screen, then on any screen. True if something took it.
static bool uiHandle(UiEvent event) {
  switch (uiScreen) {
    case UI_HOME:
      switch (event) {
        case UI_ON_ENC1_PRESS:
          uiEnter(UI_MENU1);
          uiDirty = true;
          return true;
        default:
          break;
      }
      break;
    case UI_SCREEN1:
      switch (event) {
        case UI_ON_ENC1_PRESS:
          uiEnter(UI_MENU1);
          uiDirty = true;
          return true;
        default:
          break;
      }
      break;
    case UI_SCREEN2:
      break;
    case UI_MENU1:
      switch (event) {
        case UI_ON_ENC1_LEFT:
          if (uiMenuIndex > 0) {
            uiMenuIndex--;
            if (uiMenuIndex < uiMenuTop) {
              uiMenuTop = uiMenuIndex;
            }
            uiDirty = true;
          }
          return true;
        case UI_ON_ENC1_RIGHT:
          if (uiMenuIndex + 1 < 3) {
            uiMenuIndex++;
            if (uiMenuIndex >= uiMenuTop + 3) {
              uiMenuTop = uiMenuIndex - 2;
            }
            uiDirty = true;
          }
          return true;
        case UI_ON_ENC1_PRESS:
          switch (uiMenuIndex) {
            case 0:
              uiEnter(UI_SCREEN1);
              uiDirty = true;
              break;
            case 1:
              uiEnter(UI_SCREEN2);
              uiDirty = true;
              break;
            case 2:
              uiEnter(UI_HOME);
              uiDirty = true;
              break;
            default: break;
          }
          return true;
        default:
          break;
      }
      break;
    default:
      break;
  }

  // From any screen.
  switch (event) {
    case UI_ON_BTN1:
      uiEnter(UI_HOME);
      uiDirty = true;
      return true;
    default:
      break;
  }
  return false;
}

void uiSend(UiEvent event) {
  uiHandle(event);
}

struct UiButton {
  uint8_t pin;
  bool activeLow;
  UiEvent event;
  bool pressed;
  bool raw;
  uint32_t changedAt;
};

static UiButton uiButtons[] = {
  {2, true, UI_ON_ENC1_PRESS, false, false, 0},
  {7, true, UI_ON_BTN1, false, false, 0},
};
static const uint8_t uiButtonCount = 2;

static void uiReadButtons() {
  uint32_t now = millis();
  for (uint8_t i = 0; i < uiButtonCount; i++) {
    UiButton& button = uiButtons[i];
    bool level = digitalRead(button.pin) == HIGH;
    bool raw = button.activeLow ? !level : level;
    if (raw != button.raw) {
      button.raw = raw;
      button.changedAt = now;
    }
    if (raw != button.pressed && now - button.changedAt >= 20) {
      button.pressed = raw;
      if (raw) {
        uiSend(button.event);
      }
    }
  }
}

static void uiReadEncoder_enc1() {
  static int last = HIGH;
  int now = digitalRead(4);
  if (now == LOW && last == HIGH) {
    uiSend(digitalRead(3) == HIGH ? UI_ON_ENC1_RIGHT : UI_ON_ENC1_LEFT);
  }
  last = now;
}

static bool uiTimeouts() {
  uint32_t now = millis();
  switch (uiScreen) {
    case UI_SCREEN2:
      if (now - uiEnteredAt >= 800UL) {
        uiEnter(UI_HOME);
        uiDirty = true;
        uiEnteredAt = now;
        return true;
      }

      break;
    default:
      break;
  }

  return false;
}

void uiBegin() {
  uiDisplay.init();
  uiDisplay.backlight();
  uiDisplay.clear();
  memset(uiFrame, ' ', UI_CELLS);
  memset(uiPanel, ' ', UI_CELLS);
  for (uint8_t i = 0; i < uiButtonCount; i++) {
    pinMode(uiButtons[i].pin, uiButtons[i].activeLow ? INPUT_PULLUP : INPUT);
  }
  pinMode(4, INPUT_PULLUP);
  pinMode(3, INPUT_PULLUP);
  uiEnteredAt = millis();
  uiArrive();
}

void uiUpdate() {
  uiReadButtons();
  uiReadEncoder_enc1();
  uiTimeouts();

  uint32_t now = millis();
  if (uiDirty || now - uiDrawnAt >= 100UL) {
    uiDirty = false;
    uiDrawnAt = now;
    uiDrawScreen();
  }

  uiFlush();
}
