// Generated by ArduSim from screens.json: edit it on the Экраны tab. Changes made here are overwritten.
#include "ui_screens.h"
#include <Keypad.h>
#include <EEPROM.h>

LiquidCrystal_I2C uiDisplay(0x27, 20, 4);

static UiScreen uiScreen = UI_HOME;
static bool uiDirty = true;
static uint32_t uiDrawnAt;
static uint8_t uiMenuIndex;
static uint8_t uiMenuTop;

static int32_t uiWrap(int32_t value, int32_t low, int32_t high) {
  int32_t span = high - low + 1;
  int32_t past = (value - low) % span;
  return low + (past < 0 ? past + span : past);
}

static int32_t uiClamp(int32_t value, int32_t low, int32_t high) {
  return value < low ? low : value > high ? high : value;
}

static uint8_t uiDaysIn(uint16_t year, uint8_t month) {
  static const uint8_t days[12] = {31, 28, 31, 30, 31, 30, 31, 31, 30, 31, 30, 31};
  bool leap = year % 4 == 0 && (year % 100 != 0 || year % 400 == 0);
  return month == 2 && leap ? 29 : days[month - 1];
}

int32_t uiVar_sound = 1;
int32_t uiVar_signal = 0;
UiTimer uiTimer_left = {0, 0UL, 0UL, false, true};
int32_t uiVar_total = 0;
int32_t uiVar_typing = 1;
UiTimer uiTimer_lap = {0, 0, 0, false, false};

uint32_t uiRead(const UiTimer& timer) {
  uint32_t gone = timer.running ? millis() - timer.startedAt : 0;
  if (timer.down) {
    return gone >= timer.amount ? 0 : timer.amount - gone;
  }

  return timer.amount + gone;
}

void uiStart(UiTimer& timer) {
  if (timer.running) {
    return;
  }

  if (timer.down && timer.amount == 0) {
    timer.amount = timer.full;
  }

  if (!timer.down || timer.amount > 0) {
    timer.startedAt = millis();
    timer.running = true;
  }
}

void uiStop(UiTimer& timer) {
  timer.amount = uiRead(timer);
  timer.running = false;
}

void uiReset(UiTimer& timer) {
  timer.amount = timer.down ? timer.full : 0;
  timer.running = false;
}

void uiTimerSet(UiTimer& timer, int32_t seconds) {
  timer.amount = (uint32_t)seconds * 1000UL;
  timer.full = timer.amount;
  timer.running = false;
}

// Kept at the end of EEPROM. The mark says it is this project's, written with these variables.
static const uint16_t UI_SAVED_MARK = 0xF011;
static const uint16_t UI_SAVED_BYTES = sizeof(uint16_t) + 2 * sizeof(int32_t);

void uiSave() {
  int at = EEPROM.length() - UI_SAVED_BYTES;
  uint16_t mark = UI_SAVED_MARK;
  EEPROM.put(at, mark);
  at += sizeof mark;
  EEPROM.put(at, uiVar_sound);
  at += sizeof(int32_t);
  EEPROM.put(at, uiVar_signal);
  at += sizeof(int32_t);
#if defined(ARDUINO_ARCH_ESP32) || defined(ARDUINO_ARCH_ESP8266)
  EEPROM.commit();
#endif
}

static void uiLoadSaved() {
#if defined(ARDUINO_ARCH_ESP32) || defined(ARDUINO_ARCH_ESP8266)
  EEPROM.begin(512);
#endif
  int at = EEPROM.length() - UI_SAVED_BYTES;
  uint16_t mark = 0;
  EEPROM.get(at, mark);
  if (mark != UI_SAVED_MARK) {
    return;
  }

  at += sizeof mark;
  EEPROM.get(at, uiVar_sound);
  at += sizeof(int32_t);
  EEPROM.get(at, uiVar_signal);
  at += sizeof(int32_t);
}

// The date and the time, counted from when the board started.
struct UiClock {
  uint16_t year;
  uint8_t month;
  uint8_t day;
  uint8_t hour;
  uint8_t minute;
  uint8_t second;
};

static UiClock uiClock = {2026, 1, 1, 0, 0, 0};
static uint32_t uiClockAt;

static void uiClockBegin() {
  uiClockAt = millis();
}

static void uiClockTick() {
  while (millis() - uiClockAt >= 1000) {
    uiClockAt += 1000;
    if (++uiClock.second < 60) {
      continue;
    }

    uiClock.second = 0;
    if (++uiClock.minute < 60) {
      continue;
    }

    uiClock.minute = 0;
    if (++uiClock.hour < 24) {
      continue;
    }

    uiClock.hour = 0;
    if (++uiClock.day > uiDaysIn(uiClock.year, uiClock.month)) {
      uiClock.day = 1;
      if (++uiClock.month > 12) {
        uiClock.month = 1;
        uiClock.year++;
      }
    }
  }
}

static int32_t uiClockSeconds() {
  return uiClock.hour * 3600L + uiClock.minute * 60 + uiClock.second;
}

static int32_t uiClockDate() {
  return uiClock.year * 10000L + uiClock.month * 100 + uiClock.day;
}

static void uiClockSet(int32_t seconds) {
  uiClock.hour = seconds / 3600 % 24;
  uiClock.minute = seconds / 60 % 60;
  uiClock.second = seconds % 60;
  uiClockAt = millis();
}

// Symbols and letters no character shares a shape with, five dots by eight.
static const uint8_t UI_FIRST_SYMBOL = 0x80;
static const uint8_t UI_S_bell = UI_FIRST_SYMBOL + 0;
static const uint8_t UI_S_bigTop = UI_FIRST_SYMBOL + 1;
static const uint8_t UI_S_bigBottom = UI_FIRST_SYMBOL + 2;
static const uint8_t UI_S_bigBoth = UI_FIRST_SYMBOL + 3;
static const uint8_t UI_S_U042E = UI_FIRST_SYMBOL + 4;
static const uint8_t UI_S_U0419 = UI_FIRST_SYMBOL + 5;
static const uint8_t UI_S_U0411 = UI_FIRST_SYMBOL + 6;
static const uint8_t UI_S_U0423 = UI_FIRST_SYMBOL + 7;
static const uint8_t UI_S_U0414 = UI_FIRST_SYMBOL + 8;
static const uint8_t UI_S_U042F = UI_FIRST_SYMBOL + 9;
static const uint8_t UI_S_U0427 = UI_FIRST_SYMBOL + 10;
static const uint8_t UI_S_U0418 = UI_FIRST_SYMBOL + 11;
static const uint8_t UI_S_arrowRight = UI_FIRST_SYMBOL + 12;
static const uint8_t UI_S_U0413 = UI_FIRST_SYMBOL + 13;
static const uint8_t UI_S_U041B = UI_FIRST_SYMBOL + 14;
static const uint8_t UI_S_U042B = UI_FIRST_SYMBOL + 15;
static const uint8_t UI_S_U0428 = UI_FIRST_SYMBOL + 16;
static const uint8_t UI_S_U0416 = UI_FIRST_SYMBOL + 17;

static const uint8_t uiSymbols[18][8] PROGMEM = {
  {4, 14, 14, 14, 31, 0, 4, 0}, // bell
  {31, 31, 31, 0, 0, 0, 0, 0}, // bigTop
  {0, 0, 0, 0, 0, 31, 31, 31}, // bigBottom
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  {21, 21, 21, 14, 21, 21, 21, 0}, // U0416
};

// What shows if a screen wants more than the panel's eight programmable characters.
static const char uiNearest[18] PROGMEM = {'#', '#', '#', '#', 'o', 'u', '6', 'y', 'D', 'R', '4', 'u', '#', 'r', 'J', 'b', 'w', '*'};

// A frame is drawn here first. uiFlush sends the panel only the cells that differ, a few on each pass,
// so that a whole new screen neither flickers nor keeps the keys waiting.
static const uint8_t UI_COLUMNS = 20;
static const uint8_t UI_ROWS = 4;
static const uint8_t UI_CELLS = UI_COLUMNS * UI_ROWS;
static const uint8_t UI_CELLS_PER_PASS = 4;

static uint8_t uiFrame[UI_CELLS];
static uint8_t uiPanel[UI_CELLS];
static uint8_t uiColumn;
static uint8_t uiRow;
static uint8_t uiScan;
static uint8_t uiNextCell = UI_CELLS;
static bool uiPending;

void uiAt(int x, int y, int size) {
  (void)size;
  uiColumn = x;
  uiRow = y;
}

// Past the end of a row a text is cut off, not carried to another row.
static void uiPut(uint8_t cell) {
  if (uiColumn < UI_COLUMNS && uiRow < UI_ROWS) {
    uiFrame[uiRow * UI_COLUMNS + uiColumn] = cell;
    uiColumn++;
  }
}

static void uiClear() {
  memset(uiFrame, ' ', UI_CELLS);
  uiColumn = 0;
  uiRow = 0;
}

static void uiShow() {
  uiPending = true;
}

static void uiSendCell(uint8_t at, uint8_t code) {
  if (uiNextCell != at) {
    uiDisplay.setCursor(at % UI_COLUMNS, at / UI_COLUMNS);
  }

  uiDisplay.write(code);
  // Rows do not follow each other in the panel's memory.
  uiNextCell = (at + 1) % UI_COLUMNS == 0 ? UI_CELLS : at + 1;
}

// Which symbol each of the panel's eight programmable characters holds; 0 for none.
static uint8_t uiLoaded[8];

static bool uiIsSymbol(uint8_t cell) {
  return cell >= UI_FIRST_SYMBOL && cell != 0xFF;
}

static int8_t uiSlotOf(uint8_t symbol) {
  for (uint8_t slot = 0; slot < 8; slot++) {
    if (uiLoaded[slot] == symbol) {
      return slot;
    }
  }

  return -1;
}

static void uiLoad(uint8_t slot, uint8_t symbol) {
  uint8_t rows[8];
  memcpy_P(rows, uiSymbols[symbol - UI_FIRST_SYMBOL], sizeof rows);
  uiDisplay.createChar(slot, rows);
  uiLoaded[slot] = symbol;
  // The panel's address is now in its character memory.
  uiNextCell = UI_CELLS;
}

static void uiFlush() {
  if (!uiPending) {
    return;
  }

  // What the frame wants and what the panel still shows keep their programmable characters.
  uint8_t wanted = 0;
  uint8_t shown = 0;
  uint8_t missing = 0;
  for (uint8_t i = 0; i < UI_CELLS; i++) {
    if (uiIsSymbol(uiFrame[i])) {
      int8_t slot = uiSlotOf(uiFrame[i]);
      if (slot >= 0) {
        wanted |= 1 << slot;
      } else if (missing == 0) {
        missing = uiFrame[i];
      }
    }

    if (uiIsSymbol(uiPanel[i])) {
      int8_t slot = uiSlotOf(uiPanel[i]);
      if (slot >= 0) {
        shown |= 1 << slot;
      }
    }
  }

  // Loading one takes as long as nine cells: one to a pass, and nothing else on that pass.
  if (missing != 0) {
    uint8_t held = wanted | shown;
    for (uint8_t slot = 0; slot < 8; slot++) {
      if ((held & (1 << slot)) == 0) {
        uiLoad(slot, missing);
        return;
      }
    }
  }

  uint8_t sent = 0;
  bool waiting = false;
  for (uint8_t seen = 0; seen < UI_CELLS && sent < UI_CELLS_PER_PASS; seen++) {
    uint8_t at = uiScan;
    uiScan = at + 1 == UI_CELLS ? 0 : at + 1;
    uint8_t want = uiFrame[at];
    if (want == uiPanel[at]) {
      continue;
    }

    uint8_t code = want;
    uint8_t shows = want;
    if (uiIsSymbol(want)) {
      int8_t slot = uiSlotOf(want);
      if (slot >= 0) {
        code = slot;
      } else if (wanted == 0xFF) {
        // More than eight at once: the nearest character says what was meant.
        code = pgm_read_byte(&uiNearest[want - UI_FIRST_SYMBOL]);
      } else {
        // Its character is not free yet: this cell lets go of the one it shows, if any, to help.
        waiting = true;
        if (!uiIsSymbol(uiPanel[at])) {
          continue;
        }

        code = ' ';
        shows = ' ';
      }
    }

    uiSendCell(at, code);
    uiPanel[at] = shows;
    sent++;
  }

  if (sent < UI_CELLS_PER_PASS && !waiting) {
    uiPending = false;
  }
}

UiOut uiOut;

// What each letter beyond ASCII shows.
static uint8_t uiCellOf(uint16_t code) {
  switch (code) {
    case 0x0410: return 'A';
    case 0x0411: return UI_S_U0411;
    case 0x0412: return 'B';
    case 0x0413: return UI_S_U0413;
    case 0x0414: return UI_S_U0414;
    case 0x0415: return 'E';
    case 0x0416: return UI_S_U0416;
    case 0x0417: return '3';
    case 0x0418: return UI_S_U0418;
    case 0x0419: return UI_S_U0419;
    case 0x041A: return 'K';
    case 0x041B: return UI_S_U041B;
    case 0x041C: return 'M';
    case 0x041D: return 'H';
    case 0x041E: return 'O';
    case 0x0420: return 'P';
    case 0x0421: return 'C';
    case 0x0422: return 'T';
    case 0x0423: return UI_S_U0423;
    case 0x0427: return UI_S_U0427;
    case 0x0428: return UI_S_U0428;
    case 0x042B: return UI_S_U042B;
    case 0x042E: return UI_S_U042E;
    case 0x042F: return UI_S_U042F;
    default: return '?';
  }
}

// Text comes as UTF-8, a byte at a time.
size_t UiOut::write(uint8_t ch) {
  static uint16_t code;
  static uint8_t more;
  if (ch < 0x80) {
    more = 0;
    if (ch >= ' ') {
      uiPut(ch);
    }
  } else if (ch >= 0xC0) {
    more = ch >= 0xF0 ? 3 : ch >= 0xE0 ? 2 : 1;
    code = ch & (ch >= 0xE0 ? 0x0F : 0x1F);
  } else if (more > 0) {
    code = (code << 6) | (ch & 0x3F);
    more--;
    if (more == 0) {
      uiPut(uiCellOf(code));
    }
  }

  return 1;
}

static void uiCopy(char* out, uint8_t size, const __FlashStringHelper* text) {
  strncpy_P(out, reinterpret_cast<const char*>(text), size - 1);
  out[size - 1] = 0;
}

static void uiTextTime(char* out, uint8_t size, int32_t seconds, bool hours, bool lastPair) {
  long tail = seconds % 60;
  if (!hours) {
    snprintf(out, size, "%02ld:%02ld", (long)(seconds / 60), tail);
  } else if (lastPair) {
    snprintf(out, size, "%02ld:%02ld:%02ld", (long)(seconds / 3600), (long)(seconds / 60 % 60), tail);
  } else {
    snprintf(out, size, "%02ld:%02ld", (long)(seconds / 3600), (long)(seconds / 60 % 60));
  }
}

// A date written as yyyymmdd. Order: 0 day first, 1 month first, 2 year first.
static void uiTextDate(char* out, uint8_t size, int32_t date, uint8_t order) {
  long year = date / 10000;
  long month = date / 100 % 100;
  long day = date % 100;
  if (order == 0) {
    snprintf(out, size, "%02ld.%02ld.%04ld", day, month, year);
  } else if (order == 1) {
    snprintf(out, size, "%02ld.%02ld.%04ld", month, day, year);
  } else {
    snprintf(out, size, "%04ld-%02ld-%02ld", year, month, day);
  }
}

enum UiAlign : uint8_t {
  UI_LEFT,
  UI_CENTER,
  UI_RIGHT
};

// A text in its field: where it lies there, and cut off at the field's end.
static void uiPlace(int x, int y, int size, int width, UiAlign align, const char* text) {
  int cells = 0;
  for (const char* p = text; *p != 0; p++) {
    if ((*p & 0xC0) != 0x80) {
      cells++;
    }
  }

  int room = width > cells ? width - cells : 0;
  uiAt(x + (align == UI_CENTER ? room / 2 : align == UI_RIGHT ? room : 0) * (1), y, size);
  int left = width;
  for (const char* p = text; *p != 0; p++) {
    if ((*p & 0xC0) != 0x80 && left-- == 0) {
      break;
    }

    uiOut.write((uint8_t)*p);
  }
}

// Digits three cells wide and two rows high, made of three symbols and the ROM's full block.
static const uint8_t uiBigParts[10][6] PROGMEM = {
  {0xFF, UI_S_bigTop, 0xFF, 0xFF, UI_S_bigBottom, 0xFF},
  {UI_S_bigTop, 0xFF, ' ', UI_S_bigBottom, 0xFF, UI_S_bigBottom},
  {UI_S_bigBoth, UI_S_bigBoth, 0xFF, 0xFF, UI_S_bigBottom, UI_S_bigBottom},
  {UI_S_bigBoth, UI_S_bigBoth, 0xFF, UI_S_bigBottom, UI_S_bigBottom, 0xFF},
  {0xFF, UI_S_bigBottom, 0xFF, ' ', ' ', 0xFF},
  {0xFF, UI_S_bigBoth, UI_S_bigBoth, UI_S_bigBottom, UI_S_bigBottom, 0xFF},
  {0xFF, UI_S_bigBoth, UI_S_bigBoth, 0xFF, UI_S_bigBottom, 0xFF},
  {UI_S_bigTop, UI_S_bigTop, 0xFF, ' ', ' ', 0xFF},
  {0xFF, UI_S_bigBoth, 0xFF, 0xFF, UI_S_bigBottom, 0xFF},
  {0xFF, UI_S_bigBoth, 0xFF, UI_S_bigBottom, UI_S_bigBottom, 0xFF},
};

static void uiBigText(uint8_t x, uint8_t y, const char* text) {
  for (; *text != 0; text++) {
    if (*text >= '0' && *text <= '9') {
      for (uint8_t i = 0; i < 6; i++) {
        if (i % 3 == 0) {
          uiAt(x, y + i / 3);
        }

        uiPut(pgm_read_byte(&uiBigParts[*text - '0'][i]));
      }

      x += 4;
    } else if (*text == ':') {
      uiAt(x, y);
      uiPut('.');
      uiAt(x, y + 1);
      uiPut('.');
      x += 2;
    } else {
      uiAt(x, y + 1);
      uiPut(*text);
      x += 2;
    }
  }
}

static void uiBar(int x, int y, int width, int height, int32_t value, int32_t full) {
  int32_t part = full > 0 && value > 0 ? (value > full ? full : value) : 0;
  int filled = full > 0 ? part * width / full : 0;
  (void)height;
  uiAt(x, y);
  for (int i = 0; i < filled; i++) {
    uiPut(0xFF);
  }
}

// What is being typed on the screen on view.
static uint8_t uiInputDigits[9];
static uint8_t uiInputCount;

static void uiInputAdd(char key, uint8_t most) {
  if (uiInputCount < most) {
    uiInputDigits[uiInputCount++] = key - '0';
    uiDirty = true;
  }
}

// The mask's underscores with the digits so far: from the left, or coming in from the right after zeros.
static void uiInputText(char* out, const char* mask, bool fromRight) {
  uint8_t total = 0;
  for (const char* p = mask; *p != 0; p++) {
    if (*p == '_') {
      total++;
    }
  }

  uint8_t skip = fromRight && total > uiInputCount ? total - uiInputCount : 0;
  uint8_t at = 0;
  for (; *mask != 0; mask++) {
    if (*mask != '_') {
      *out++ = *mask;
    } else {
      *out++ = at < skip ? '0' : at - skip < uiInputCount ? '0' + uiInputDigits[at - skip] : '_';
      at++;
    }
  }

  *out = 0;
}

// Some of the digits as a number, counted as the mask counts them.
static int32_t uiInputNumber(uint8_t first, uint8_t count, uint8_t total) {
  uint8_t skip = total > uiInputCount ? total - uiInputCount : 0;
  int32_t number = 0;
  for (uint8_t i = first; i < first + count; i++) {
    number = number * 10 + (i < skip ? 0 : uiInputDigits[i - skip]);
  }

  return number;
}

static void uiSayItem_menu1(uint8_t index) {
  switch (index) {
    case 0:
      uiOut.print(F("ЗВУК"));
      break;
    case 1:
      uiOut.print(F("СИГНАЛ"));
      break;
    case 2:
      uiOut.print(F("ВРЕМЯ"));
      break;
    case 3:
      uiOut.print(F("НАЗАД"));
      break;
    default:
      break;
  }
}

// What an item shows at its row's right edge.
static void uiItemRight_menu1(uint8_t index, int y) {
  switch (index) {
    case 0: {
      char text[41] = "";
      switch ((int32_t)(uiVar_sound)) {
        case 0: uiCopy(text, sizeof text, F("НЕТ")); break;
        case 1: uiCopy(text, sizeof text, F("ДА")); break;
        default: text[0] = 0; break;
      }
      uiPlace(0, y, 1, 20, UI_RIGHT, text);
      break;
    }
    case 1: {
      char text[41] = "";
      switch ((int32_t)(uiVar_signal)) {
        case 0: uiCopy(text, sizeof text, F("КОРОТКО")); break;
        case 1: uiCopy(text, sizeof text, F("ДОЛГО")); break;
        default: text[0] = 0; break;
      }
      uiPlace(0, y, 1, 20, UI_RIGHT, text);
      break;
    }
    default:
      break;
  }
}

static void uiDrawMenu_menu1() {
  {
    char text[8];
    snprintf(text, sizeof text, "%d/%d", uiMenuIndex + 1, 4);
    uiPlace(0, 0, 1, 20, UI_RIGHT, text);
  }
  if (uiMenuTop + 0 < 4) {
    uiAt(0, 1, 1);
    if (uiMenuTop + 0 == uiMenuIndex) {
      uiPut(UI_S_arrowRight);
    } else {
      uiOut.print(F(" "));
    }
    uiSayItem_menu1(uiMenuTop + 0);
    uiItemRight_menu1(uiMenuTop + 0, 1);
  }
  if (uiMenuTop + 1 < 4) {
    uiAt(0, 2, 1);
    if (uiMenuTop + 1 == uiMenuIndex) {
      uiPut(UI_S_arrowRight);
    } else {
      uiOut.print(F(" "));
    }
    uiSayItem_menu1(uiMenuTop + 1);
    uiItemRight_menu1(uiMenuTop + 1, 2);
  }
  if (uiMenuTop + 2 < 4) {
    uiAt(0, 3, 1);
    if (uiMenuTop + 2 == uiMenuIndex) {
      uiPut(UI_S_arrowRight);
    } else {
      uiOut.print(F(" "));
    }
    uiSayItem_menu1(uiMenuTop + 2);
    uiItemRight_menu1(uiMenuTop + 2, 3);
  }
}

static void uiSayItem_menu2(uint8_t index) {
  switch (index) {
    case 0:
      uiOut.print(F("ТАЙМЕР"));
      break;
    case 1:
      uiOut.print(F("СЕКУНДОМЕР"));
      break;
    case 2:
      uiOut.print(F("НАСТРОЙКИ"));
      break;
    case 3:
      uiOut.print(F("НАЗАД"));
      break;
    default:
      break;
  }
}

static void uiDrawMenu_menu2() {
  {
    char text[8];
    snprintf(text, sizeof text, "%d/%d", uiMenuIndex + 1, 4);
    uiPlace(0, 0, 1, 20, UI_RIGHT, text);
  }
  if (uiMenuTop + 0 < 4) {
    uiAt(0, 1, 1);
    if (uiMenuTop + 0 == uiMenuIndex) {
      uiPut(UI_S_arrowRight);
    } else {
      uiOut.print(F(" "));
    }
    uiSayItem_menu2(uiMenuTop + 0);
  }
  if (uiMenuTop + 1 < 4) {
    uiAt(0, 2, 1);
    if (uiMenuTop + 1 == uiMenuIndex) {
      uiPut(UI_S_arrowRight);
    } else {
      uiOut.print(F(" "));
    }
    uiSayItem_menu2(uiMenuTop + 1);
  }
  if (uiMenuTop + 2 < 4) {
    uiAt(0, 3, 1);
    if (uiMenuTop + 2 == uiMenuIndex) {
      uiPut(UI_S_arrowRight);
    } else {
      uiOut.print(F(" "));
    }
    uiSayItem_menu2(uiMenuTop + 2);
  }
}

// Часы
static void uiDraw_home() {
  if (uiVar_sound) {
    uiAt(0, 0, 1);
    uiPut(UI_S_bell);
  }
  {
    char text[21] = "";
    uiTextDate(text, sizeof text, uiClockDate(), 0);
    uiPlace(10, 0, 1, 10, UI_RIGHT, text);
  }
  {
    char text[16] = "";
    uiTextTime(text, sizeof text, uiClockSeconds(), true, false);
    uiBigText(0, 1, text);
  }
  {
    char text[16] = "";
    snprintf(text, sizeof text, "%02ld", (long)((int32_t)uiClock.second));
    uiPlace(18, 2, 1, 2, UI_LEFT, text);
  }
  uiAt(0, 3, 1);
  uiOut.print(F("A:МЕНЮ"));
  uiAt(12, 3, 1);
  uiOut.print(F("#:ТАЙМЕР"));
}

// Таймер
static void uiDraw_screen1() {
  uiAt(0, 0, 1);
  uiOut.print(F("ТАЙМЕР"));
  if (!uiVar_typing) {
    uiBar(8, 0, 12, 10, (int32_t)((uiRead(uiTimer_left) + 999) / 1000), uiVar_total);
  }
  if (uiVar_typing) {
    {
      char text[6];
      uiInputText(text, "__:__", true);
      uiPlace(7, 1, 1, 5, UI_LEFT, text);
    }
  }
  if (!uiVar_typing) {
    {
      char text[16] = "";
      uiTextTime(text, sizeof text, (int32_t)((uiRead(uiTimer_left) + 999) / 1000), false, true);
      uiBigText(1, 1, text);
    }
  }
  uiAt(0, 3, 1);
  uiOut.print(F("#:СТАРТ"));
  uiAt(13, 3, 1);
  uiOut.print(F("D:СБРОС"));
}

// Секундомер
static void uiDraw_screen2() {
  uiAt(0, 0, 1);
  uiOut.print(F("СЕКУНДОМЕР"));
  {
    char text[16] = "";
    uiTextTime(text, sizeof text, (int32_t)(uiRead(uiTimer_lap) / 1000), false, true);
    uiBigText(1, 1, text);
  }
  {
    char text[17] = "";
    {
      int32_t ms = (int32_t)uiRead(uiTimer_lap);
      snprintf(text, sizeof text, "%02ld:%02ld.%02ld", (long)(ms / 60000), (long)(ms / 1000 % 60), (long)(ms / 10 % 100));
    }
    uiPlace(12, 0, 1, 8, UI_RIGHT, text);
  }
  uiAt(0, 3, 1);
  uiOut.print(F("#:СТАРТ"));
  uiAt(13, 3, 1);
  uiOut.print(F("D:СБРОС"));
}

// Установка времени
static void uiDraw_screen3() {
  uiAt(0, 0, 1);
  uiOut.print(F("ВРЕМЯ"));
  uiAt(12, 0, 1);
  uiOut.print(F("ЧЧ:ММ:СС"));
  {
    char text[9];
    uiInputText(text, "__:__:__", false);
    uiPlace(6, 1, 1, 8, UI_LEFT, text);
  }
  uiAt(0, 3, 1);
  uiOut.print(F("#:ОК D:СТЕР *:НАЗАД"));
}

// Настройки
static void uiDraw_menu1() {
  uiAt(0, 0, 1);
  uiOut.print(F("НАСТРОЙКИ"));
  uiDrawMenu_menu1();
}

// Меню
static void uiDraw_menu2() {
  uiAt(0, 0, 1);
  uiOut.print(F("МЕНЮ"));
  uiDrawMenu_menu2();
}

// Время вышло
static void uiDraw_screen4() {
  uiAt(2, 1, 1);
  uiPut(UI_S_bell);
  uiOut.print(F(" ВРЕМЯ ВЫШЛО "));
  uiPut(UI_S_bell);
  uiAt(3, 3, 1);
  uiOut.print(F("НАЖМИ КЛАВИШУ"));
}

static void uiDrawScreen() {
  uiClear();
  switch (uiScreen) {
    case UI_HOME:
      uiDraw_home();
      break;
    case UI_SCREEN1:
      uiDraw_screen1();
      break;
    case UI_SCREEN2:
      uiDraw_screen2();
      break;
    case UI_SCREEN3:
      uiDraw_screen3();
      break;
    case UI_MENU1:
      uiDraw_menu1();
      break;
    case UI_MENU2:
      uiDraw_menu2();
      break;
    case UI_SCREEN4:
      uiDraw_screen4();
      break;
    default:
      break;
  }
  uiShow();
}

static bool uiCommit_screen1() {
  if (uiInputCount == 0) {
    return false;
  }

  int32_t minutes = uiInputNumber(0, 2, 4);
  int32_t seconds = uiInputNumber(2, 2, 4);
  if (seconds > 59) {
    return false;
  }

  uiTimerSet(uiTimer_left, minutes * 60 + seconds);
  return true;
}

static bool uiCommit_screen3() {
  if (uiInputCount < 6) {
    return false;
  }

  int32_t hours = uiInputNumber(0, 2, 6);
  int32_t minutes = uiInputNumber(2, 2, 6);
  int32_t seconds = uiInputNumber(4, 2, 6);
  if (hours > 23 || minutes > 59 || seconds > 59) {
    return false;
  }

  uiClockSet(hours * 3600 + minutes * 60 + seconds);
  return true;
}

static bool uiArrive() {
  switch (uiScreen) {
    case UI_SCREEN1:
      uiInputCount = 0;
      break;
    case UI_SCREEN3:
      uiInputCount = 0;
      break;
    default:
      break;
  }
  return true;
}

// Where it came from, so that the way back is the way it came.
struct UiVisit {
  UiScreen screen;
  uint8_t index;
  uint8_t top;
};

static const uint8_t UI_DEPTH = 8;
static UiVisit uiVisits[UI_DEPTH];
static uint8_t uiVisitCount;

static void uiEnter(UiScreen next) {
  if (next == uiScreen) {
    uiDirty = true;
    uiArrive();
    return;
  }

  // A screen already on the way here is gone back to, so that the way never grows without end.
  for (uint8_t i = uiVisitCount; i-- > 0;) {
    if (uiVisits[i].screen == next) {
      uiVisitCount = i;
      uiScreen = next;
      uiMenuIndex = uiVisits[i].index;
      uiMenuTop = uiVisits[i].top;
      uiDirty = true;
      return;
    }
  }

  if (uiVisitCount == UI_DEPTH) {
    memmove(uiVisits, uiVisits + 1, sizeof uiVisits - sizeof uiVisits[0]);
    uiVisitCount--;
  }

  uiVisits[uiVisitCount].screen = uiScreen;
  uiVisits[uiVisitCount].index = uiMenuIndex;
  uiVisits[uiVisitCount].top = uiMenuTop;
  uiVisitCount++;
  uiScreen = next;
  uiMenuIndex = 0;
  uiMenuTop = 0;
  uiDirty = true;
  uiArrive();
}

void uiBack() {
  if (uiVisitCount == 0) {
    return;
  }

  uiVisitCount--;
  uiScreen = uiVisits[uiVisitCount].screen;
  uiMenuIndex = uiVisits[uiVisitCount].index;
  uiMenuTop = uiVisits[uiVisitCount].top;
  uiDirty = true;
}

void uiGoTo(UiScreen screen) {
  uiEnter(screen);
}

void uiRedraw() {
  uiDirty = true;
}

UiScreen uiCurrent() {
  return uiScreen;
}

// What an event does on each screen, then on any screen. True if something took it.
static bool uiHandle(UiEvent event) {
  switch (uiScreen) {
    case UI_HOME:
      switch (event) {
        case UI_ON_KEY_A:
          uiEnter(UI_MENU2);
          uiDirty = true;
          return true;
        case UI_ON_KEY_HASH:
          uiEnter(UI_SCREEN1);
          uiDirty = true;
          return true;
        default:
          break;
      }
      break;
    case UI_SCREEN1:
      switch (event) {
        case UI_ON_KEY_HASH:
          if (uiVar_typing) {
            if (!uiCommit_screen1()) {
              uiInputCount = 0;
              uiDirty = true;
              return true;
            }
            uiVar_total = uiClamp((int32_t)((uiRead(uiTimer_left) + 999) / 1000), 0, 5999);
            uiStart(uiTimer_left);
            uiVar_typing = (0) ? 1 : 0;
            uiDirty = true;
            return true;
          }
          if (uiTimer_left.running) { uiStop(uiTimer_left); } else { uiStart(uiTimer_left); }
          uiDirty = true;
          return true;
        case UI_ON_KEY_D:
          if (uiVar_typing) {
            if (uiInputCount > 0) { uiInputCount--; }
            uiDirty = true;
            return true;
          }
          uiReset(uiTimer_left);
          uiInputCount = 0;
          uiVar_typing = (1) ? 1 : 0;
          uiDirty = true;
          return true;
        case UI_ON_KEY_STAR:
          uiBack();
          uiDirty = true;
          return true;
        default:
          break;
      }
      break;
    case UI_SCREEN2:
      switch (event) {
        case UI_ON_KEY_HASH:
          if (uiTimer_lap.running) { uiStop(uiTimer_lap); } else { uiStart(uiTimer_lap); }
          uiDirty = true;
          return true;
        case UI_ON_KEY_D:
          uiReset(uiTimer_lap);
          uiDirty = true;
          return true;
        case UI_ON_KEY_STAR:
          uiBack();
          uiDirty = true;
          return true;
        default:
          break;
      }
      break;
    case UI_SCREEN3:
      switch (event) {
        case UI_ON_KEY_HASH:
          if (!uiCommit_screen3()) {
            uiInputCount = 0;
            uiDirty = true;
            return true;
          }
          uiBack();
          uiDirty = true;
          return true;
        case UI_ON_KEY_D:
          if (uiInputCount > 0) { uiInputCount--; }
          uiDirty = true;
          return true;
        case UI_ON_KEY_STAR:
          uiBack();
          uiDirty = true;
          return true;
        default:
          break;
      }
      break;
    case UI_MENU1:
      switch (event) {
        case UI_ON_KEY_S2:
          if (uiMenuIndex > 0) {
            uiMenuIndex--;
            if (uiMenuIndex < uiMenuTop) {
              uiMenuTop = uiMenuIndex;
            }
            uiDirty = true;
          }
          return true;
        case UI_ON_KEY_S8:
          if (uiMenuIndex + 1 < 4) {
            uiMenuIndex++;
            if (uiMenuIndex >= uiMenuTop + 3) {
              uiMenuTop = uiMenuIndex - 2;
            }
            uiDirty = true;
          }
          return true;
        case UI_ON_KEY_HASH:
          switch (uiMenuIndex) {
            case 0:
              uiVar_sound = (!uiVar_sound) ? 1 : 0; uiSave();
              uiDirty = true;
              break;
            case 1:
              uiVar_signal = uiWrap((uiVar_signal + 1) % 2, 0, 1); uiSave();
              uiDirty = true;
              break;
            case 2:
              uiEnter(UI_SCREEN3);
              uiDirty = true;
              break;
            case 3:
              uiBack();
              uiDirty = true;
              break;
            default: break;
          }
          return true;
        case UI_ON_KEY_STAR:
          uiBack();
          uiDirty = true;
          return true;
        default:
          break;
      }
      break;
    case UI_MENU2:
      switch (event) {
        case UI_ON_KEY_S2:
          if (uiMenuIndex > 0) {
            uiMenuIndex--;
            if (uiMenuIndex < uiMenuTop) {
              uiMenuTop = uiMenuIndex;
            }
            uiDirty = true;
          }
          return true;
        case UI_ON_KEY_S8:
          if (uiMenuIndex + 1 < 4) {
            uiMenuIndex++;
            if (uiMenuIndex >= uiMenuTop + 3) {
              uiMenuTop = uiMenuIndex - 2;
            }
            uiDirty = true;
          }
          return true;
        case UI_ON_KEY_HASH:
          switch (uiMenuIndex) {
            case 0:
              uiEnter(UI_SCREEN1);
              uiDirty = true;
              break;
            case 1:
              uiEnter(UI_SCREEN2);
              uiDirty = true;
              break;
            case 2:
              uiEnter(UI_MENU1);
              uiDirty = true;
              break;
            case 3:
              uiBack();
              uiDirty = true;
              break;
            default: break;
          }
          return true;
        case UI_ON_KEY_STAR:
          uiBack();
          uiDirty = true;
          return true;
        default:
          break;
      }
      break;
    case UI_SCREEN4:
      switch (event) {
        case UI_ON_ANY_KEY:
          uiBack();
          uiDirty = true;
          return true;
        default:
          break;
      }
      break;
    default:
      break;
  }

  // From any screen.
  switch (event) {
    case UI_DONE_LEFT:
      if (uiVar_sound && uiVar_signal == 1) {
        tone(10, 1500, 1500);
        uiVar_typing = (1) ? 1 : 0;
        uiEnter(UI_SCREEN4);
        uiDirty = true;
        return true;
      }
      if (uiVar_sound) {
        tone(10, 1500, 300);
        uiVar_typing = (1) ? 1 : 0;
        uiEnter(UI_SCREEN4);
        uiDirty = true;
        return true;
      }
      uiVar_typing = (1) ? 1 : 0;
      uiEnter(UI_SCREEN4);
      uiDirty = true;
      return true;
    case UI_ON_KEY_B:
      uiEnter(UI_HOME);
      uiDirty = true;
      return true;
    default:
      break;
  }
  return false;
}

void uiSend(UiEvent event) {
  uiHandle(event);
}

// A press nothing on the screen took is still any key.
static void uiPress(UiEvent event) {
  if (!uiHandle(event)) {
    uiHandle(UI_ON_ANY_KEY);
  }
}

static const char uiKeys_kp1[4][4] = {{'1', '2', '3', 'A'}, {'4', '5', '6', 'B'}, {'7', '8', '9', 'C'}, {'*', '0', '#', 'D'}};
static byte uiRows_kp1[4] = {9, 8, 7, 6};
static byte uiColumns_kp1[4] = {5, 4, 3, 2};
static Keypad uiKeypad_kp1(makeKeymap(uiKeys_kp1), uiRows_kp1, uiColumns_kp1, 4, 4);

static void uiOnKey(char key) {
  switch (key) {
    case 'A':
      if (uiHandle(UI_ON_KEY_A)) {
        return;
      }

      break;
    case '#':
      if (uiHandle(UI_ON_KEY_HASH)) {
        return;
      }

      break;
    case 'D':
      if (uiHandle(UI_ON_KEY_D)) {
        return;
      }

      break;
    case '*':
      if (uiHandle(UI_ON_KEY_STAR)) {
        return;
      }

      break;
    case 'B':
      if (uiHandle(UI_ON_KEY_B)) {
        return;
      }

      break;
    case '2':
      if (uiHandle(UI_ON_KEY_S2)) {
        return;
      }

      break;
    case '8':
      if (uiHandle(UI_ON_KEY_S8)) {
        return;
      }

      break;
    default:
      break;
  }

  switch (uiScreen) {
    case UI_SCREEN1:
      if (key >= '0' && key <= '9') {
        uiInputAdd(key, 4);
        return;
      }

      break;
    case UI_SCREEN3:
      if (key >= '0' && key <= '9') {
        uiInputAdd(key, 6);
        return;
      }

      break;
    default:
      break;
  }

  uiHandle(UI_ON_ANY_KEY);
}

struct UiButton {
  uint8_t pin;
  bool activeLow;
  UiEvent event;
  bool pressed;
  bool raw;
  uint32_t changedAt;
};

static UiButton uiButtons[] = {
  {0, true, UI_NO_EVENT, false, false, 0},
};
static const uint8_t uiButtonCount = 0;

static void uiReadButtons() {
  uint32_t now = millis();
  for (uint8_t i = 0; i < uiButtonCount; i++) {
    UiButton& button = uiButtons[i];
    bool level = digitalRead(button.pin) == HIGH;
    bool raw = button.activeLow ? !level : level;
    if (raw != button.raw) {
      button.raw = raw;
      button.changedAt = now;
    }
    if (raw != button.pressed && now - button.changedAt >= 20) {
      button.pressed = raw;
      if (raw) {
        uiPress(button.event);
      }
    }
  }
}

void uiBegin() {
  uiDisplay.init();
  uiDisplay.backlight();
  uiDisplay.clear();
  memset(uiFrame, ' ', UI_CELLS);
  memset(uiPanel, ' ', UI_CELLS);
  for (uint8_t i = 0; i < uiButtonCount; i++) {
    pinMode(uiButtons[i].pin, uiButtons[i].activeLow ? INPUT_PULLUP : INPUT);
  }
  uiLoadSaved();
  uiClockBegin();
  uiArrive();
}

void uiUpdate() {
  uiClockTick();
  uiReadButtons();
  {
    char key = uiKeypad_kp1.getKey();
    if (key) {
      uiOnKey(key);
    }
  }

  if (uiTimer_left.running && uiRead(uiTimer_left) == 0) {
    uiTimer_left.running = false;
    uiTimer_left.amount = 0;
    uiDirty = true;
    uiHandle(UI_DONE_LEFT);
  }

  uint32_t now = millis();
  if (uiDirty || now - uiDrawnAt >= 100UL) {
    uiDirty = false;
    uiDrawnAt = now;
    uiDrawScreen();
  }

  uiFlush();
}
